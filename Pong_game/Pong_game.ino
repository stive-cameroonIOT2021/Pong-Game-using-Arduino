

/*
  A simple Pong game:
 */

#include <SPI.h>
#include <Wire.h>
#include <Adafruit_GFX.h>
#include <Adafruit_SSD1306.h>

// Bitmap of ronaldo Image
const unsigned char ronaldo [] PROGMEM = {
  0xff, 0xff, 0xff, 0xff, 0xff, 0xff, 0xff, 0xff, 0xff, 0xff, 0xff, 0xff, 0xff, 0xff, 0xff, 0xff,
  0xff, 0xff, 0xff, 0xff, 0xff, 0xff, 0xff, 0xf8, 0x07, 0xff, 0xff, 0xff, 0xff, 0xff, 0xff, 0xff,
  0xff, 0xff, 0xff, 0xff, 0xff, 0xff, 0xff, 0x80, 0x0f, 0xff, 0xff, 0xff, 0xff, 0xff, 0xff, 0xff,
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  0xff, 0xff, 0xff, 0xff, 0xff, 0xfc, 0x7d, 0xff, 0xfc, 0x00, 0x7d, 0xff, 0xff, 0xff, 0xff, 0xff
};

const unsigned char thumb_up[] PROGMEM = {
  0xff, 0xff, 0xff, 0x8f, 0xff, 0xfe, 0xff, 0xff, 0xff, 0xb3, 0xff, 0xfe, 0xff, 0xff, 0xff, 0xbb, 
  0xff, 0xfe, 0xff, 0xff, 0xff, 0xb9, 0xff, 0xfe, 0xff, 0xff, 0xff, 0x79, 0xff, 0xfe, 0xff, 0xff, 
  0xff, 0x7b, 0xff, 0xfe, 0xff, 0xff, 0xff, 0x7b, 0xff, 0xfe, 0xff, 0xff, 0xff, 0x7b, 0xff, 0xfe, 
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  0x0f, 0xff, 0xff, 0xfe
};


#define UP_BUTTON 2
#define DOWN_BUTTON 3

const unsigned long PADDLE_RATE = 33;
const unsigned long BALL_RATE = 16;
const uint8_t PADDLE_HEIGHT = 24;

#define SCREEN_WIDTH 128 // OLED display width, in pixels
#define SCREEN_HEIGHT 64 // OLED display height, in pixels

// Declaration for an SSD1306 display connected to I2C (SDA, SCL pins)
#define OLED_RESET     4 // Reset pin # (or -1 if sharing Arduino reset pin)
Adafruit_SSD1306 display(SCREEN_WIDTH, SCREEN_HEIGHT, &Wire, OLED_RESET);

void drawCourt();

uint8_t ball_x = 64, ball_y = 32;
uint8_t ball_dir_x = 1, ball_dir_y = 1;
unsigned long ball_update;

unsigned long paddle_update;
const uint8_t CPU_X = 12;
uint8_t cpu_y = 16;

const uint8_t PLAYER_X = 115;
uint8_t player_y = 16;

void setup() {
    display.begin(SSD1306_SWITCHCAPVCC, 0x3C);

    
    display.display();
    unsigned long start = millis();

    pinMode(UP_BUTTON, INPUT);
    pinMode(DOWN_BUTTON, INPUT);
    digitalWrite(UP_BUTTON,1);
    digitalWrite(DOWN_BUTTON,1);
    display.clearDisplay();
    drawCourt();

    while(millis() - start < 2000);

    display.display();

    ball_update = millis();
    paddle_update = ball_update;
}

void loop() {
    bool update = false;
    unsigned long time = millis();

    static bool up_state = false;
    static bool down_state = false;
    
    up_state |= (digitalRead(UP_BUTTON) == LOW);
    down_state |= (digitalRead(DOWN_BUTTON) == LOW);

    if(time > ball_update) {
        uint8_t new_x = ball_x + ball_dir_x;
        uint8_t new_y = ball_y + ball_dir_y;

        // Check if we hit the vertical walls
        if(new_x == 0 || new_x == 127) {
            ball_dir_x = -ball_dir_x;
            new_x += ball_dir_x + ball_dir_x;
        }

        // Check if we hit the horizontal walls.
        if(new_y == 0 || new_y == 63) {
            ball_dir_y = -ball_dir_y;
            new_y += ball_dir_y + ball_dir_y;
        }

        // Check if we hit the CPU paddle
        if(new_x == CPU_X && new_y >= cpu_y && new_y <= cpu_y + PADDLE_HEIGHT) {
            ball_dir_x = -ball_dir_x;
            new_x += ball_dir_x + ball_dir_x;
        }

        // Check if we hit the player paddle
        if(new_x == PLAYER_X
           && new_y >= player_y
           && new_y <= player_y + PADDLE_HEIGHT)
        {
            ball_dir_x = -ball_dir_x;
            new_x += ball_dir_x + ball_dir_x;
        }

        //check if ball cross player paddles
        else if(new_x > PLAYER_X){
          display.clearDisplay();
          display.setTextSize(2);
          int x = (display.width() - (24 * 2 * 2)) / 2;
          int y = (display.height() - (8 * 2)) / 2;
          display.setTextColor(WHITE);
          display.setCursor(x, y);
          display.println("YOU LOSE");
          display.display();
          delay(2000);
          // Clear the buffer.
          display.clearDisplay();
          // Display bitmap
          display.drawBitmap(0, 0,  thumb_up, 47, 30, WHITE);
          display.setTextSize(1);
          display.setTextColor(WHITE);
          display.setCursor(0, 40);
          display.println("Follow for more!!");
          display.display();
          delay(2000);
          // Clear the buffer.
          display.clearDisplay();
          while(1){        
            // Display bitmap
          display.drawBitmap(0, 0,  ronaldo, 128, 64, WHITE);
          display.display();
          delay(4000);
          // Clear the buffer.
          display.clearDisplay();
          display.setTextSize(2);
          int x = (display.width() - (10 * 2 * 2)) / 2;
          int y = (display.height() - (8 * 2)) / 2;
          display.setTextColor(WHITE);
          display.setCursor(x, y);
          display.println("SIU!!");
          display.display();
          delay(1000);
          // Clear the buffer.
          display.clearDisplay();
            }
          }

        display.drawPixel(ball_x, ball_y, BLACK);
        display.drawPixel(new_x, new_y, WHITE);
        ball_x = new_x;
        ball_y = new_y;

        ball_update += BALL_RATE;

        update = true;
    }

    if(time > paddle_update) {
        paddle_update += PADDLE_RATE;

        // CPU paddle
        display.drawFastVLine(CPU_X, cpu_y, PADDLE_HEIGHT, BLACK);
        const uint8_t half_paddle = PADDLE_HEIGHT >> 1;
        if(cpu_y + half_paddle > ball_y) {
            cpu_y -= 1;
        }
        if(cpu_y + half_paddle < ball_y) {
            cpu_y += 1;
        }
        if(cpu_y < 1) cpu_y = 1;
        if(cpu_y + PADDLE_HEIGHT > 63) cpu_y = 63 - PADDLE_HEIGHT;
        display.drawFastVLine(CPU_X, cpu_y, PADDLE_HEIGHT, WHITE);

        // Player paddle
        display.drawFastVLine(PLAYER_X, player_y, PADDLE_HEIGHT, BLACK);
        if(up_state) {
            player_y -= 1;
        }
        if(down_state) {
            player_y += 1;
        }
        up_state = down_state = false;
        if(player_y < 1) player_y = 1;
        if(player_y + PADDLE_HEIGHT > 63) player_y = 63 - PADDLE_HEIGHT;
        display.drawFastVLine(PLAYER_X, player_y, PADDLE_HEIGHT, WHITE);

        update = true;
    }

    if(update)
        display.display();
}


void drawCourt() {
    display.drawRect(0, 0, 128, 64, WHITE);
}
